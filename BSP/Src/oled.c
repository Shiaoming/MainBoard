#include "includes.h"

/*********************************************
OLED模块显示
*********************************************/


//======================================================
// 128X64I液晶底层驱动[6X8]字体库
//======================================================
const unsigned char f6x8[][6] =
{
    { 0x00, 0x00, 0x00, 0x00, 0x00, 0x00 },   // sp
    { 0x00, 0x00, 0x00, 0x2f, 0x00, 0x00 },   // !
    { 0x00, 0x00, 0x07, 0x00, 0x07, 0x00 },   // "
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    { 0x14, 0x14, 0x14, 0x14, 0x14, 0x14 }    // horiz lines
};

//======================================================
// 128X64I液晶底层驱动[8X16]字体库
// 描  述: [8X16]西文字符的字模数据 (纵向取模,字节倒序)
// !"#$%&'()*+,-./0123456789:;<=>?@ABCDEFGHIJKLMNOPQRSTUVWXYZ[\]^_`abcdefghijklmnopqrstuvwxyz{|}~
//======================================================
const unsigned char f8X16[]=
{
	0x00,0x00,0x00,0x00,0x00,0x00,0x00,0x00,0x00,0x00,0x00,0x00,0x00,0x00,0x00,0x00,// 0
  0x00,0x00,0x00,0xF8,0x00,0x00,0x00,0x00,0x00,0x00,0x00,0x33,0x30,0x00,0x00,0x00,//!1
  0x00,0x10,0x0C,0x06,0x10,0x0C,0x06,0x00,0x00,0x00,0x00,0x00,0x00,0x00,0x00,0x00,//"2
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  0x00,0x06,0x01,0x01,0x02,0x02,0x04,0x04,0x00,0x00,0x00,0x00,0x00,0x00,0x00,0x00,//~94

};

void OLED_DLY_INT(int time)
{
	OS_ERR err;
	OSTimeDly(1,OS_OPT_TIME_MATCH,&err);
	
	time = time;
}

void OLED_WrDat(unsigned char data)
{
	unsigned char i=8;
	//OLED_CS=0;;
	OLED_DC_Set();
	OLED_DLY_INT(1);
	OLED_SCL_Clr();
	OLED_DLY_INT(1);
	//asm("nop");
	while(i--)
	{
		if(data&0x80){OLED_SDA_Set();
		OLED_DLY_INT(1);}
		else{OLED_SDA_Clr();
		OLED_DLY_INT(1);}
		OLED_SCL_Set();
		OLED_DLY_INT(1);
		asm("nop");;
			//asm("nop");
		OLED_SCL_Clr();
		OLED_DLY_INT(1);
		data<<=1;
	}
	//OLED_CS=1;
}
void OLED_WrCmd(unsigned char cmd)
{
	unsigned char i=8;

	//OLED_CS=0;;
	OLED_DC_Clr();
	OLED_DLY_INT(1);
	OLED_SCL_Clr();
	OLED_DLY_INT(1);
	//asm("nop");
	while(i--)
	{
		if(cmd&0x80)
		{
			OLED_SDA_Set();
			OLED_DLY_INT(1);
		}
		else
		{
			OLED_SDA_Clr();
			OLED_DLY_INT(1);
		}
		OLED_SCL_Set();
		OLED_DLY_INT(1);
		asm("nop");;
		//asm("nop");
		OLED_SCL_Clr();
		OLED_DLY_INT(1);
		cmd<<=1;;
	}
	//OLED_CS=1;
}
void OLED_Set_Pos(unsigned char x, unsigned char y)
{
	OLED_WrCmd(0xb0+y);
	OLED_WrCmd(((x&0xf0)>>4)|0x10);
	OLED_WrCmd((x&0x0f)|0x01);
}

void OLED_Fill(unsigned char bmp_data)
{
	unsigned char y,x;

	for(y=0;y<8;y++)
	{
		OLED_WrCmd(0xb0+y);
		OLED_WrCmd(0x01);
		OLED_WrCmd(0x10);
		for(x=0;x<128;x++)
			OLED_WrDat(bmp_data);
	}
}



void OLED_CLS(void)
{
	unsigned char y,x;
	for(y=0;y<8;y++)
	{
		OLED_WrCmd(0xb0+y);
		OLED_WrCmd(0x01);
		OLED_WrCmd(0x10);
		for(x=0;x<128;x++)
			OLED_WrDat(0);
	}
}

//void OLED_CLS_X(uint xwidth)//清除 xwidth 前的屏幕
//{
//	unsigned char y,x;
//	for(y=0;y<8;y++)
//	{
//		OLED_WrCmd(0xb0+y);
//		OLED_WrCmd(0x01);
//		OLED_WrCmd(0x10);
//		for(x=0;x<=xwidth;x++)
//			OLED_WrDat(0);
//	}
//}

//void OLED_CLS_Xmin_Xmax(unsigned char xwidthmin,unsigned char xwidthmax)//清除 xwidthmin ~ xwidthmax 之间的屏幕
//{
//	unsigned char y,x;
//	for(y=0;y<8;y++)
//	{
//		OLED_WrCmd(0xb0+y);
//		OLED_WrCmd(0x01);
//		OLED_WrCmd(0x10);
//		for(x=xwidthmin;x<=xwidthmax;x++)
//			OLED_WrDat(0);
//	}
//}


void OLED_DLY_ms_i(int ms)
{
  	int volatile tmp1;
	int i;
	for(i = 0;i < 8400;i++)
	{
		tmp1 = ms;
		while(tmp1--);
	}
}

void OLED_Init(void)
{
#ifdef USEOLED
	GPIO_InitTypeDef  GPIO_InitStructure;

 	OLED_GPIO_Port_Enable();

	GPIO_InitStructure.GPIO_Pin = 	OLED_GPIO_SDA | OLED_GPIO_SCL | \
									OLED_GPIO_RST | OLED_GPIO_DC;
	GPIO_InitStructure.GPIO_Speed = GPIO_Fast_Speed;
	GPIO_InitStructure.GPIO_Mode = GPIO_Mode_OUT;
	GPIO_InitStructure.GPIO_OType = GPIO_OType_PP;
	GPIO_InitStructure.GPIO_PuPd = GPIO_PuPd_UP;	// 上拉输出
 	GPIO_Init(OLED_GPIO_PORT, &GPIO_InitStructure);

	//DelayInit();//延时初始化

	OLED_SCL_Set();
	//OLED_CS=1;	//预制SLK和SS为高电平

	OLED_RST_Clr();
	OLED_DLY_ms(50);
	OLED_RST_Set();

	OLED_WrCmd(0xae);//--turn off oled panel
	OLED_WrCmd(0x00);//---set low column address
	OLED_WrCmd(0x10);//---set high column address
	OLED_WrCmd(0x40);//--set start line address  Set Mapping RAM Display Start Line (0x00~0x3F)
	OLED_WrCmd(0x81);//--set contrast control register
	OLED_WrCmd(0xcf); // Set SEG Output Current Brightness
	OLED_WrCmd(0xa1);//--Set SEG/Column Mapping     0xa0左右反置 0xa1正常
	OLED_WrCmd(0xc8);//Set COM/Row Scan Direction   0xc0上下反置 0xc8正常
	OLED_WrCmd(0xa6);//--set normal display
	OLED_WrCmd(0xa8);//--set multiplex ratio(1 to 64)
	OLED_WrCmd(0x3f);//--1/64 duty
	OLED_WrCmd(0xd3);//-set display offset	Shift Mapping RAM Counter (0x00~0x3F)
	OLED_WrCmd(0x00);//-not offset
	OLED_WrCmd(0xd5);//--set display clock divide ratio/oscillator frequency
	OLED_WrCmd(0x80);//--set divide ratio, Set Clock as 100 Frames/Sec
	OLED_WrCmd(0xd9);//--set pre-charge period
	OLED_WrCmd(0xf1);//Set Pre-Charge as 15 Clocks & Discharge as 1 Clock
	OLED_WrCmd(0xda);//--set com pins hardware configuration
	OLED_WrCmd(0x12);
	OLED_WrCmd(0xdb);//--set vcomh
	OLED_WrCmd(0x40);//Set VCOM Deselect Level
	OLED_WrCmd(0x20);//-Set Page Addressing Mode (0x00/0x01/0x02)
	OLED_WrCmd(0x02);//
	OLED_WrCmd(0x8d);//--set Charge Pump enable/disable
	OLED_WrCmd(0x14);//--set(0x10) disable
	OLED_WrCmd(0xa4);// Disable Entire Display On (0xa4/0xa5)
	OLED_WrCmd(0xa6);// Disable Inverse Display On (0xa6/a7)
	OLED_WrCmd(0xaf);//--turn on oled panel
	OLED_Fill(0x00);  //初始清屏
	OLED_Set_Pos(0,0);
#endif
}
//==============================================================
//函数名：OLED_P6x8Str(unsigned char x,unsigned char y,unsigned char *p)
//功能描述：写入一组标准ASCII字符串
//参数：显示的位置（x,y），y为页范围0～7，要显示的字符串
//返回：无
//==============================================================
void OLED_P6x8Str(unsigned char x,unsigned char y,unsigned char ch[])
{
#ifdef USEOLED
	unsigned char c=0,i=0,j=0;
	while (ch[j]!='\0')
	{
		c =ch[j]-32;
		if(x>126){x=0;y++;}
			OLED_Set_Pos(x,y);
		for(i=0;i<6;i++)
			OLED_WrDat(f6x8[c][i]);
		x+=6;
		j++;
	}
#endif
}

//==============================================================
//函数名：OLED_P8x16Str(unsigned char x,unsigned char y,unsigned char *p)
//功能描述：写入一组标准ASCII字符串
//参数：显示的位置（x,y），y为页范围0～7，要显示的字符串
//返回：无
//==============================================================
void OLED_P8x16Str(unsigned char x,unsigned char y,unsigned char ch[])
{
#ifdef USEOLED
	unsigned char c=0,i=0,j=0;

	while (ch[j]!='\0')
	{
		c =ch[j]-32;
		if(x>120){x=0;y++;}
			OLED_Set_Pos(x,y);
		for(i=0;i<8;i++)
			OLED_WrDat(f8X16[c*16+i]);
		OLED_Set_Pos(x,y+1);
		for(i=0;i<8;i++)
			OLED_WrDat(f8X16[c*16+i+8]);
		x+=8;
		j++;
	}
#endif
}

void OLED_Init_Show(void)
{
//	// 标题
	OLED_P8x16Str(0,0,"ROBOCON 2016");
//	OLED_P6x8Str(97,1,"-BJTU");
//
//	// 时间
//	OLED_P6x8Str(0,2,"  :  :  ");
//	// CPU使用率
//	OLED_P6x8Str(66,2,"CPU:");
//	OLED_P6x8Str(90,2,"00.00%");
//
//	// 期望坐标
//	OLED_P6x8Str(0,3,"E:");
//	OLED_P6x8Str(16,3,"0.000,0.000,0.000");
//	// 坐标位置
//	OLED_P6x8Str(0,4,"C:");
//	OLED_P6x8Str(16,4,"0.000,0.000,0.000");
//	// 速度值
//	OLED_P6x8Str(0,5,"S:");
//	OLED_P6x8Str(16,5,"0.000,0.000,0.000");
//
//	// 期望按键速度值
//	OLED_P6x8Str(0,6,"EXPS:");
//	OLED_P6x8Str(30,6," 50");

}



